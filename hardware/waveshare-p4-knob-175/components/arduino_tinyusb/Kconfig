## hardware/waveshare-p4-knob-175/components/arduino_tinyusb/Kconfig
```kconfig
menu "Arduino TinyUSB"
# Same choices as the prebuilt library (framework-arduinoespressif32-libs/esp32p4/sdkconfig).
config TINYUSB_ENABLED
    bool "Enable TinyUSB driver"
    default y
menu "Serial (CDC) driver"
config TINYUSB_CDC_ENABLED
    bool "Enable USB Serial (CDC) TinyUSB driver"
    default y
    depends on TINYUSB_ENABLED
config TINYUSB_DESC_CDC_STRING
    string "CDC Device String"
    default "Espressif CDC Device"
    depends on TINYUSB_CDC_ENABLED
config TINYUSB_CDC_RX_BUFSIZE
    int "CDC FIFO size of RX"
    default 512
    depends on TINYUSB_CDC_ENABLED
config TINYUSB_CDC_TX_BUFSIZE
    int "CDC FIFO size of TX"
    default 512
    depends on TINYUSB_CDC_ENABLED
config TINYUSB_CDC_MAX_PORTS
    int "Maximum enabled CDC ports"
    range 1 2
    default 2
    depends on TINYUSB_CDC_ENABLED
endmenu
menu "Mass Storage (MSC) driver"
config TINYUSB_MSC_ENABLED
    bool "Enable USB Mass Storage TinyUSB driver"
    default y
    depends on TINYUSB_ENABLED
config TINYUSB_DESC_MSC_STRING
    string "MSC Device String"
    default "Espressif MSC Device"
    depends on TINYUSB_MSC_ENABLED
config TINYUSB_MSC_BUFSIZE
    int "MSC Buffer size"
    default 4096
    depends on TINYUSB_MSC_ENABLED
endmenu
menu "Human Interface (HID) driver"
config TINYUSB_HID_ENABLED
    bool "Enable USB HID TinyUSB driver"
    default y
    depends on TINYUSB_ENABLED
config TINYUSB_DESC_HID_STRING
    string "HID Device String"
    default "Espressif HID Device"
    depends on TINYUSB_HID_ENABLED
config TINYUSB_HID_BUFSIZE
    int "HID Buffer size"
    default 512
    depends on TINYUSB_HID_ENABLED
endmenu
menu "MIDI driver"
config TINYUSB_MIDI_ENABLED
    bool "Enable USB MIDI TinyUSB driver"
    default y
    depends on TINYUSB_ENABLED
config TINYUSB_DESC_MIDI_STRING
    string "MIDI Device String"
    default "Espressif MIDI Device"
    depends on TINYUSB_MIDI_ENABLED
config TINYUSB_MIDI_RX_BUFSIZE
    int "MIDI FIFO size of RX"
    default 512
    depends on TINYUSB_MIDI_ENABLED
config TINYUSB_MIDI_TX_BUFSIZE
    int "MIDI FIFO size of TX"
    default 512
    depends on TINYUSB_MIDI_ENABLED
endmenu
menu "AUDIO driver"
config TINYUSB_AUDIO_ENABLED
    bool "Enable USB Audio TinyUSB driver"
    default y
    depends on TINYUSB_ENABLED
config TINYUSB_DESC_AUDIO_STRING
    string "AUDIO Device String"
    default "Espressif AUDIO Device"
    depends on TINYUSB_AUDIO_ENABLED
endmenu
menu "VIDEO driver"
config TINYUSB_VIDEO_ENABLED
    bool "Enable USB Video TinyUSB driver"
    default y
    depends on TINYUSB_ENABLED
config TINYUSB_DESC_VIDEO_STRING
    string "VIDEO Device String"
    default "Espressif VIDEO Device"
    depends on TINYUSB_VIDEO_ENABLED
config TINYUSB_VIDEO_STREAMING_BUFSIZE
    int "VIDEO streaming endpoint size"
    default 512
    depends on TINYUSB_VIDEO_ENABLED
config TINYUSB_VIDEO_STREAMING_IFS
    int "Number of VIDEO streaming interfaces"
    range 1 3
    default 1
    depends on TINYUSB_VIDEO_ENABLED
endmenu
menu "DFU Runtime driver"
config TINYUSB_DFU_RT_ENABLED
    bool "Enable USB DFU Runtime TinyUSB driver"
    default y
    depends on TINYUSB_ENABLED
config TINYUSB_DESC_DFU_RT_STRING
    string "DFU_RT Device String"
    default "Espressif DFU_RT Device"
    depends on TINYUSB_DFU_RT_ENABLED
endmenu
menu "DFU driver"
config TINYUSB_DFU_ENABLED
    bool "Enable USB DFU TinyUSB driver"
    default y
    depends on TINYUSB_ENABLED
config TINYUSB_DESC_DFU_STRING
    string "DFU Device String"
    default "Espressif DFU Device"
    depends on TINYUSB_DFU_ENABLED
config TINYUSB_DFU_BUFSIZE
    int "DFU buffer size"
    default 4096
    depends on TINYUSB_DFU_ENABLED
endmenu
menu "VENDOR driver"
config TINYUSB_VENDOR_ENABLED
    bool "Enable USB VENDOR TinyUSB driver"
    default y
    depends on TINYUSB_ENABLED
config TINYUSB_DESC_VENDOR_STRING
    string "VENDOR Device String"
    default "Espressif VENDOR Device"
    depends on TINYUSB_VENDOR_ENABLED
config TINYUSB_VENDOR_RX_BUFSIZE
    int "VENDOR FIFO size of RX"
    default 512
    depends on TINYUSB_VENDOR_ENABLED
config TINYUSB_VENDOR_TX_BUFSIZE
    int "VENDOR FIFO size of TX"
    default 512
    depends on TINYUSB_VENDOR_ENABLED
endmenu
menu "NCM driver"
config TINYUSB_NCM_ENABLED
    bool "Enable USB NCM TinyUSB driver"
    default y
    depends on TINYUSB_ENABLED
endmenu
config TINYUSB_DEBUG_LEVEL
    int "TinyUSB log level (0-3)"
    default 0
    range 0 3
    depends on TINYUSB_ENABLED
endmenu
```
